## Kconfig.zslice
```kconfig
config ZSLICE
	bool "zslice support"
	select COBS
	select NANOPB
	select NET_BUF
	default n
	help
	  This option enables zslice.

if ZSLICE

config ZSLICE_CRC
	bool "Enables CRC error detection"
	depends on CRC
	default n
	help
	  This option enables the use of CRC for zslice packets.
	  Does not enable for all transports.

config ZSLICE_ACKS
	bool "Enables acknowledgements for packets"
	default n
	help
	  This option enables the use of acknowledgements for zslice packets.
	  Does not enable for all transports.

endif
```
